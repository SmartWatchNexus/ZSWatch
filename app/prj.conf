## CMakeLists.txt
```
cmake_minimum_required(VERSION 3.20.0)

# Apply patches before build
file(GLOB_RECURSE files RELATIVE ${CMAKE_SOURCE_DIR} "patches/*.patch")
foreach(file ${files})
    execute_process(COMMAND 
                    patch -p1 -d $ENV{ZEPHYR_BASE} -i ${CMAKE_CURRENT_SOURCE_DIR}/${file} -r - --no-backup-if-mismatch)
endforeach()

string(REGEX MATCH "zswatch_nrf5340_cpuapp(_ns)?@([0-9]+)$" ZSWATCH_BOARD "${BOARD}")
if(ZSWATCH_BOARD)
    set(ZSWATCH_REV ${CMAKE_MATCH_2})
    if(${ZSWATCH_REV} EQUAL 2)
        set(DFU_BUILD true)
        set(PM_STATIC_YML_FILE ${CMAKE_CURRENT_SOURCE_DIR}/partition_mcuboot.yml)
        set(OVERLAY_CONFIG ${CMAKE_CURRENT_SOURCE_DIR}/boards/dfu.conf)
        set(mcuboot_DTC_OVERLAY_FILE ${CMAKE_CURRENT_SOURCE_DIR}/overlays/mcuboot.overlay)
    elseif(${ZSWATCH_REV} GREATER_EQUAL 3)
        set(PM_STATIC_YML_FILE ${CMAKE_CURRENT_SOURCE_DIR}/partition_external.yml)
    else()
        set(PM_STATIC_YML_FILE ${CMAKE_CURRENT_SOURCE_DIR}/partition_internal.yml)
    endif()
endif()

if("nrf5340dk_nrf5340_cpuapp" STREQUAL "${BOARD}")
    set(PM_STATIC_YML_FILE ${CMAKE_CURRENT_SOURCE_DIR}/partition_external.yml)
endif()

set(BOARD_ROOT ${CMAKE_CURRENT_SOURCE_DIR})

find_package(Zephyr REQUIRED HINTS $ENV{ZEPHYR_BASE})
project(ZSWatchFW)

# These are XIP related anomalies and aren't applicable for us and cause
# throughput issues and QSPI issues on NCS 2.6.0
zephyr_compile_definitions(
  -DNRF53_ERRATA_43_ENABLE_WORKAROUND=0
  -DNRF52_ERRATA_215_ENABLE_WORKAROUND=0
  -DNRF53_ERRATA_159_ENABLE_WORKAROUND=0 #Not allowing 128MHz CPU with QPSI at same time. We take the risk of this errata that may cause currupt QPSI data.
)

add_subdirectory(drivers)
add_subdirectory(src/history)
add_subdirectory(src/applications)
add_subdirectory(src/ui/watchfaces)
add_subdirectory(src/sensors)
add_subdirectory(src/sensor_fusion)
add_subdirectory(src/events)
add_subdirectory(src/managers)
add_subdirectory(src/drivers)
add_subdirectory(src/ble)
add_subdirectory(src/images)

include_directories(src/)
include_directories(src/ui)
include_directories(src/applications)
include_directories(src/ui/watchfaces)

if (CONFIG_DT_HAS_NORDIC_NPM1300_ENABLED)
add_subdirectory(src/fuel_gauge)
else()
add_subdirectory(src/basic_battery)
endif()

target_sources(app PRIVATE src/main.c)
target_sources(app PRIVATE src/zsw_clock.c)
target_sources(app PRIVATE src/zsw_cpu_freq.c)
target_sources(app PRIVATE src/zsw_retained_ram_storage.c)
target_sources(app PRIVATE src/zsw_coredump.c)

target_sources(app PRIVATE src/ui/notification/zsw_popup_notifcation.c)
target_sources(app PRIVATE src/ui/popup/zsw_popup_window.c)
target_sources(app PRIVATE src/ui/utils/zsw_ui_utils.c)

target_sources(app PRIVATE src/ui/watchfaces/zsw_watchface_dropdown_ui.c)

target_sources_ifdef(CONFIG_SPI_FLASH_LOADER app PRIVATE src/filesystem/zsw_rtt_flash_loader.c)
target_sources_ifdef(CONFIG_FILE_SYSTEM_LITTLEFS app PRIVATE src/filesystem/zsw_filesystem.c)
target_sources_ifdef(CONFIG_FILE_SYSTEM_LITTLEFS app PRIVATE src/filesystem/zsw_lvgl_spi_decoder.c)

if(DFU_BUILD)
    target_sources(app PRIVATE src/dfu.c)
endif()

FILE(GLOB events_sources src/events/*.c)
target_sources(app PRIVATE ${events_sources})

add_compile_definitions(LV_LVGL_H_INCLUDE_SIMPLE)

file(GLOB ext_fs_files "src/images/binaries/S/*.*")
list(LENGTH ext_fs_files num_ext_fs_files)
add_compile_definitions(NUM_RAW_FS_FILES=${num_ext_fs_files})
message("Number of external filesystem files:" ${num_ext_fs_files})

# TODO fix all of them. New since NCS 2.7
set_target_properties(app PROPERTIES COMPILE_FLAGS -Wno-double-promotion)
zephyr_compile_options(-Wno-double-promotion)
```

## prj.conf
```kconfig
CONFIG_MAIN_STACK_SIZE=2048
CONFIG_SYSTEM_WORKQUEUE_STACK_SIZE=10000
CONFIG_HEAP_MEM_POOL_SIZE=32000
CONFIG_CBPRINTF_FP_SUPPORT=y
CONFIG_DEBUG_THREAD_INFO=y

CONFIG_ASSERT=y
CONFIG_REBOOT=y
CONFIG_DISPLAY=y
CONFIG_BASE64=y

CONFIG_RETAINED_MEM=y
CONFIG_RETENTION=y
CONFIG_RETENTION_BOOT_MODE=y

CONFIG_I2C=y
CONFIG_SENSOR=y
CONFIG_ADC=y
CONFIG_LIS2MDL=y
CONFIG_LIS2MDL_MAG_ODR_RUNTIME=y
CONFIG_LIS2MDL_TRIGGER_OWN_THREAD=y

CONFIG_PINCTRL=y
CONFIG_PM_DEVICE=y
CONFIG_PM_DEVICE_RUNTIME=y

CONFIG_PWM=y

CONFIG_COUNTER=y
CONFIG_NRFX_TIMER1=y

CONFIG_SPI=y
CONFIG_GC9A01=y
CONFIG_INPUT=y
CONFIG_REGULATOR=y
CONFIG_REGULATOR_FIXED=y

# LVGL configuration
CONFIG_LVGL=y
CONFIG_LV_Z_FLUSH_THREAD=y
CONFIG_LV_Z_FLUSH_THREAD_PRIO=0
CONFIG_LV_FONT_MONTSERRAT_10=y
CONFIG_LV_FONT_MONTSERRAT_12=y
CONFIG_LV_FONT_MONTSERRAT_14=y
CONFIG_LV_FONT_MONTSERRAT_16=y
CONFIG_LV_FONT_MONTSERRAT_18=y
CONFIG_LV_Z_POINTER_INPUT_MSGQ_COUNT=200
CONFIG_LV_Z_POINTER_INPUT=y

CONFIG_LV_Z_DOUBLE_VDB=y
CONFIG_LV_Z_VDB_SIZE=10
CONFIG_LV_DISP_DEF_REFR_PERIOD=30
CONFIG_LV_INDEV_DEF_READ_PERIOD=30

CONFIG_LV_THEME_DEFAULT_DARK=y

# LVGL Size optimizations
CONFIG_LV_LABEL_TEXT_SELECTION=n
CONFIG_LV_LABEL_LONG_TXT_HINT=n
CONFIG_LV_USE_LOG=y
CONFIG_LV_USE_BAR=y
CONFIG_LV_USE_CANVAS=n
CONFIG_LV_USE_CHECKBOX=n
CONFIG_LV_USE_DROPDOWN=y
CONFIG_LV_USE_LINE=y
CONFIG_LV_USE_ROLLER=n
CONFIG_LV_USE_SLIDER=y
CONFIG_LV_USE_SWITCH=y
CONFIG_LV_USE_TABLE=n
CONFIG_LV_USE_TEXTAREA=n
CONFIG_LV_USE_FLEX=y
CONFIG_LV_USE_ANIMIMG=y
CONFIG_LV_USE_CALENDAR=n
CONFIG_LV_USE_CHART=y
CONFIG_LV_USE_COLORWHEEL=n
CONFIG_LV_USE_IMGBTN=y
CONFIG_LV_USE_KEYBOARD=n
CONFIG_LV_USE_LED=y
CONFIG_LV_USE_LIST=y
CONFIG_LV_USE_MENU=y
CONFIG_LV_USE_METER=y
CONFIG_LV_USE_MSGBOX=y
CONFIG_LV_USE_SPINBOX=n
CONFIG_LV_USE_SPINNER=y
CONFIG_LV_USE_TABVIEW=n
CONFIG_LV_USE_TILEVIEW=y
CONFIG_LV_USE_WIN=n
CONFIG_LV_USE_SPAN=n
CONFIG_LV_USE_USER_DATA=y
CONFIG_LV_USE_TEXTAREA=y
CONFIG_LV_USE_GIF=y

CONFIG_LV_COLOR_16_SWAP=y
CONFIG_LV_COLOR_DEPTH_16=y

#
# Memory settings
#
CONFIG_LV_Z_MEM_POOL_SIZE=128000
# end of Memory settings

# NVS
CONFIG_FLASH=y
CONFIG_FLASH_MAP=y
CONFIG_MPU_ALLOW_FLASH_WRITE=y
CONFIG_FLASH_PAGE_LAYOUT=y
CONFIG_FLASH_MAP_LABELS=y

CONFIG_SETTINGS=y
CONFIG_NVS=y

# Bluetooth
CONFIG_BT=y
CONFIG_BT_HCI=y
CONFIG_BT_HCI_ACL_FLOW_CONTROL=n
CONFIG_BT_CTLR=n
# Enable chaining of multiple CTEs in periodic advertising
CONFIG_BT_DEBUG_LOG=n
CONFIG_BT_SMP=y
CONFIG_BT_PERIPHERAL=y
CONFIG_BT_DIS=y
CONFIG_BT_DIS_PNP=n
CONFIG_BT_DIS_HW_REV=y
CONFIG_BT_DIS_MODEL="ZSWatch"
CONFIG_BT_BAS=y
CONFIG_BT_HRS=n
CONFIG_BT_DEVICE_NAME="ZSWatch"
CONFIG_BT_DEVICE_APPEARANCE=194
CONFIG_BT_KEYS_OVERWRITE_OLDEST=y
CONFIG_BT_SETTINGS=y
CONFIG_BT_MAX_PAIRED=5
CONFIG_BT_MAX_CONN=2
CONFIG_BT_GATT_CLIENT=y
CONFIG_BT_GATT_CACHING=y
CONFIG_BT_GATT_NOTIFY_MULTIPLE=y

CONFIG_BT_BROADCASTER=y
CONFIG_BT_SMP_ALLOW_UNAUTH_OVERWRITE=y
CONFIG_BT_ECC=y
CONFIG_BT_CONN_TX_MAX=3

CONFIG_BT_L2CAP_TX_MTU=498
CONFIG_BT_BUF_ACL_RX_SIZE=502
CONFIG_BT_BUF_ACL_TX_SIZE=502

# iOS ble GATT server
CONFIG_BT_GATTP=y
CONFIG_BT_GATT_DM=y
CONFIG_BT_AMS_CLIENT=y
CONFIG_BT_ANCS_CLIENT=y
CONFIG_BT_CTS_CLIENT=y

# Don't change this
CONFIG_BT_RECV_WORKQ_SYS=y

CONFIG_PICOLIBC=y
CONFIG_PICOLIBC_IO_FLOAT=y
CONFIG_POSIX_API=y

# By default disable UART to save power
CONFIG_SERIAL=n
CONFIG_CONSOLE=n
CONFIG_UART_CONSOLE=n

CONFIG_ZBUS=y
CONFIG_ZBUS_RUNTIME_OBSERVERS=y
CONFIG_ZBUS_CHANNEL_NAME=y
CONFIG_ZBUS_OBSERVER_NAME=y

# Choose one or many of below
CONFIG_WATCHFACE_ANALOG=n
CONFIG_WATCHFACE_DIGITAL=y
CONFIG_WATCHFACE_MINIMAL=y

# Choose one of below
CONFIG_WATCHFACE_BACKGROUND_SPACE=n
CONFIG_WATCHFACE_BACKGROUND_FLOWER=n
CONFIG_WATCHFACE_BACKGROUND_PLANET=n
CONFIG_WATCHFACE_BACKGROUND_NONE=y

# Default watch
CONFIG_POWER_MANAGEMENT_IDLE_TIMEOUT_SECONDS=20
CONFIG_DEFAULT_CONFIGURATION_SENSORS_SUMMARY_REFRESH_INTERVAL_MS=100

# CST816S
CONFIG_INPUT_CST816S_INTERRUPT=y
CONFIG_INPUT_CST816S=n
CONFIG_INPUT_MODIFIED_CST816S=y

# BMI270
CONFIG_BMI270_PLUS=y
CONFIG_BMI270_PLUS_TRIGGER_GLOBAL_THREAD=y

# Uncomment for BME688 IAQ using Bosch BSEC
#CONFIG_BME680=n
#CONFIG_EXTERNAL_USE_BOSCH_BSEC=y

CONFIG_RESET_ON_FATAL_ERROR=y

CONFIG_DEBUG_COREDUMP=y
CONFIG_DEBUG_COREDUMP_MEMORY_DUMP_MIN=y
CONFIG_RETENTION_MUTEX_FORCE_DISABLE=y
CONFIG_RETAINED_MEM_MUTEX_FORCE_DISABLE=y
CONFIG_RETENTION_BUFFER_SIZE=256

CONFIG_ZBUS_CHANNELS_SYS_INIT_PRIORITY=1

CONFIG_CJSON_LIB=y
```

## boards/debug.conf
```kconfig
CONFIG_BLE_DISABLE_PAIRING_REQUIRED=y
CONFIG_SENSOR_LOG_LEVEL_WRN=y
CONFIG_THREAD_NAME=y
CONFIG_PRINTK=y

# SEGGER RTT logging instead of UART
CONFIG_LOG_PRINTK=y
CONFIG_LOG=y
CONFIG_DEBUG_OPTIMIZATIONS=y
CONFIG_USE_SEGGER_RTT=y
CONFIG_LOG_BACKEND_RTT=y
CONFIG_LOG_BACKEND_RTT_MODE_BLOCK=y
CONFIG_LOG_BUFFER_SIZE=4096
CONFIG_LOG_BACKEND_RTT_OUTPUT_BUFFER_SIZE=128
CONFIG_LOG_BLOCK_IN_THREAD=y
# End of SEGGER RTT

# Comment out to show FPS counter
CONFIG_LV_USE_PERF_MONITOR=n
#CONFIG_LV_PERF_MONITOR_ALIGN_RIGHT_MID=y

CONFIG_ZSW_APP_LOG_LEVEL_WRN=y
CONFIG_ZSW_SENSORS_LOG_LEVEL_WRN=y
CONFIG_ZSW_BLE_LOG_LEVEL_WRN=y
CONFIG_ZSW_SETTINGS_APP_LOG_LEVEL_WRN=y
CONFIG_ZSW_APP_LOG_LEVEL_DBG=y
```

## src/main.c
```c
/*
 * This file is part of ZSWatch project <https://github.com/jakkra/ZSWatch/>.
 * Copyright (c) 2023 Jakob Krantz.
 *
 * This program is free software: you can redistribute it and/or modify
 * it under the terms of the GNU General Public License as published by
 * the Free Software Foundation, version 3.
 *
 * This program is distributed in the hope that it will be useful, but
 * WITHOUT ANY WARRANTY; without even the implied warranty of
 * MERCHANTABILITY or FITNESS FOR A PARTICULAR PURPOSE. See the GNU
 * General Public License for more details.
 *
 * You should have received a copy of the GNU General Public License
 * along with this program. If not, see <http://www.gnu.org/licenses/>.
 */

#include <zephyr/device.h>
#include <stdio.h>
#include <string.h>
#include <zephyr/kernel.h>
#include <zephyr/pm/device.h>
#include <zephyr/pm/policy.h>
#include <zephyr/bluetooth/bluetooth.h>
#include <zephyr/settings/settings.h>
#include <zephyr/logging/log.h>
#include <zephyr/logging/log_ctrl.h>
#include <zsw_clock.h>
#include <lvgl.h>
#include <sys/time.h>
#include <zephyr/zbus/zbus.h>
#include <zsw_cpu_freq.h>
#include <zephyr/bluetooth/bluetooth.h>
#include <zephyr/task_wdt/task_wdt.h>
#include <zephyr/fatal.h>
#include <zephyr/input/input.h>
#include <zephyr/retention/bootmode.h>
#include <zephyr/sys/reboot.h>
#include "dfu.h"
#include "ui/zsw_ui.h"
#include "ble/ble_comm.h"
#include "ble/ble_aoa.h"
#include "events/accel_event.h"
#include "events/ble_event.h"
#include "sensors/zsw_imu.h"
#include "drivers/zsw_buzzer.h"
#include "sensors/zsw_magnetometer.h"
#include "sensors/zsw_pressure_sensor.h"
#include "sensors/zsw_light_sensor.h"
#include "sensors/zsw_environment_sensor.h"
#include <zsw_retained_ram_storage.h>
#include "drivers/zsw_vibration_motor.h"
#include "drivers/zsw_display_control.h"
#include "managers/zsw_power_manager.h"
#include "managers/zsw_app_manager.h"
#include "managers/zsw_notification_manager.h"
#include "applications/watchface/watchface_app.h"
#include <filesystem/zsw_rtt_flash_loader.h>
#include <filesystem/zsw_filesystem.h>
#include "ui/popup/zsw_popup_window.h"
#include "ble/ble_ams.h"
#include "ble/ble_ancs.h"
#include "ble/ble_cts.h"
#include <zsw_coredump.h>
#include "fuel_gauge/zsw_pmic.h"

LOG_MODULE_REGISTER(main, CONFIG_ZSW_APP_LOG_LEVEL);

#define TASK_WDT_FEED_INTERVAL_MS  3000

typedef enum ui_state {
    INIT_STATE,
    WATCHFACE_STATE,
    APPLICATION_MANAGER_STATE,
} ui_state_t;

static struct input_worker_item_t {
    struct k_work work;
    struct input_event event;
} input_worker_item;

struct input_event last_input_event;

static void run_input_work(struct k_work *item);
static void run_init_work(struct k_work *item);

static void run_wdt_work(struct k_work *item);
static void enable_bluetooth(void);
static void print_retention_ram(void);
static void enocoder_read(struct _lv_indev_drv_t *indev_drv, lv_indev_data_t *data);
static void click_feedback(struct _lv_indev_drv_t *drv, uint8_t e);
static void open_notification_popup(void *data);
static void async_turn_off_buttons_allocation(void *unused);
static void open_application_manager_page(void *app_name);
static void handle_screen_gesture(lv_dir_t event_code);

static void on_application_manager_close(void);
static void on_popup_notifcation_closed(uint32_t id);
static void on_zbus_notification_callback(const struct zbus_channel *chan);
static void on_zbus_ble_data_callback(const struct zbus_channel *chan);
static void on_input_subsys_callback(struct input_event *evt);
static void on_watchface_app_event_callback(watchface_app_evt_t evt);
static void on_lvgl_screen_gesture_event_callback(lv_event_t *e);

static int kernal_wdt_id;

static lv_group_t *input_group;
static lv_group_t *temp_group;

static lv_indev_drv_t enc_drv;
static lv_indev_t *enc_indev;
static uint8_t last_pressed;

static lv_obj_t *root_screen;

static bool pending_not_open;
static bool is_buttons_for_lvgl = false;

static ui_state_t watch_state = INIT_STATE;

K_WORK_DELAYABLE_DEFINE(wdt_work, run_wdt_work);
K_WORK_DEFINE(init_work, run_init_work);
K_WORK_DEFINE(input_work, run_input_work);

ZBUS_CHAN_DECLARE(ble_comm_data_chan);
ZBUS_LISTENER_DEFINE(main_ble_comm_lis, on_zbus_ble_data_callback);
ZBUS_LISTENER_DEFINE(main_notification_lis, on_zbus_notification_callback);

static void run_input_work(struct k_work *item)
{
    struct input_worker_item_t *container = CONTAINER_OF(item, struct input_worker_item_t, work);

    LOG_DBG("Input worker code: %u", container->event.code);

    // Don't process the press if it caused wakeup.
    if (zsw_power_manager_reset_idle_timout()) {
        return;
    }

    switch (container->event.code) {
        // Button event
        case (INPUT_KEY_Y): {
#ifdef CONFIG_MISC_ENABLE_SYSTEM_RESET
            LOG_INF("Force restart");

            retained.off_count += 1;
            zsw_retained_ram_update();
            sys_reboot(SYS_REBOOT_COLD);
#endif
            break;
        }
        // Button event
        case INPUT_KEY_3: {
            if (zsw_notification_popup_is_shown()) {
                zsw_notification_popup_remove();
            } else if (watch_state == APPLICATION_MANAGER_STATE) {
                zsw_app_manager_exit_app();

                return;
            }

            break;
        }
        case INPUT_KEY_1: {
            if ((watch_state == WATCHFACE_STATE) && !zsw_notification_popup_is_shown()) {
                watch_state = APPLICATION_MANAGER_STATE;
                zsw_vibration_run_pattern(ZSW_VIBRATION_PATTERN_CLICK);
                lv_async_call(open_application_manager_page, NULL);
            }

            break;
        }
    }

    // Handle the input events. We have to take care about the screen orientation for the touch events.
    lv_dir_t gesture_code = LV_DIR_NONE;
    switch (container->event.code) {
        // Watch: Slide from right to left.
        case INPUT_BTN_NORTH: {
            gesture_code = LV_DIR_LEFT;
            break;
        }
        // Watch: Slide from left to right.
        case INPUT_BTN_SOUTH: {
            gesture_code = LV_DIR_RIGHT;
            break;
        }
        // Watch: Slide from bottom to top.
        case INPUT_BTN_WEST: {
            gesture_code = LV_DIR_TOP;
            break;
        }
        // Watch: Slide from top to bottom.
        case INPUT_BTN_EAST: {
            gesture_code = LV_DIR_BOTTOM;
            break;
        }
    }

    if (is_buttons_for_lvgl && (gesture_code == LV_DIR_NONE)) {
        // Handled by LVGL
        last_input_event.code = container->event.code;
        return;
    }
}

static void run_init_work(struct k_work *item)
{
    lv_indev_t *touch_indev;

    root_screen = lv_scr_act();

    zsw_coredump_init();
    lv_obj_set_style_bg_color(root_screen, zsw_color_dark_gray(), LV_PART_MAIN | LV_STATE_DEFAULT);
    zsw_display_control_init();
    zsw_display_control_sleep_ctrl(true);
    print_retention_ram();
    zsw_notification_manager_init();
    enable_bluetooth();
    zsw_imu_init();
    zsw_magnetometer_init();
    zsw_pressure_sensor_init();
    zsw_light_sensor_init();
    zsw_environment_sensor_init();

    // Need to enable the gpio-keys as they are suspended by default
    pm_device_action_run(DEVICE_DT_GET(DT_NODELABEL(buttons)), PM_DEVICE_ACTION_RESUME);
    INPUT_CALLBACK_DEFINE(NULL, on_input_subsys_callback);

    lv_indev_drv_init(&enc_drv);
    enc_drv.type = LV_INDEV_TYPE_ENCODER;
    enc_drv.read_cb = enocoder_read;
    enc_drv.feedback_cb = click_feedback;
    enc_indev = lv_indev_drv_register(&enc_drv);

    input_group = lv_group_create();
    temp_group = lv_group_create();
    lv_group_set_default(input_group);
    lv_indev_set_group(enc_indev, input_group);

    touch_indev = lv_indev_get_next(NULL);
    while (touch_indev) {
        if (lv_indev_get_type(touch_indev) == LV_INDEV_TYPE_POINTER) {
            // TODO First fix so not all presses everywhere are registered as clicks and cause vibration
            // Clicking anywehere with this below added right now will cause a vibration, which
            // is not what we want
            // touch_indev->driver->feedback_cb = click_feedback;
            break;
        }
        touch_indev = lv_indev_get_next(touch_indev);
    }

    watch_state = WATCHFACE_STATE;

    lv_obj_add_event_cb(root_screen, on_lvgl_screen_gesture_event_callback, LV_EVENT_GESTURE, NULL);

    watchface_app_start(root_screen, input_group, on_watchface_app_event_callback);

#ifdef CONFIG_SPI_FLASH_LOADER
    if (NUM_RAW_FS_FILES != zsw_filesytem_get_num_rawfs_files()) {
        LOG_ERR("Number of rawfs files does not match the number of files in the file table: %d / %d",
                zsw_filesytem_get_num_rawfs_files(), NUM_RAW_FS_FILES);
        zsw_popup_show("Warning", "Missing files in external flash\nPlease run:\nwest upload_fs", NULL, 5, false);
    }
#endif

#if defined(CONFIG_TASK_WDT) && !defined(CONFIG_BOARD_NATIVE_POSIX)
    const struct device *hw_wdt_dev = DEVICE_DT_GET(DT_ALIAS(watchdog0));
    if (!device_is_ready(hw_wdt_dev)) {
        LOG_DBG("Hardware watchdog %s is not ready; ignoring it.",
                hw_wdt_dev->name);
        hw_wdt_dev = NULL;
    }

    task_wdt_init(hw_wdt_dev);
    kernal_wdt_id = task_wdt_add(TASK_WDT_FEED_INTERVAL_MS * 5, NULL, NULL);

    k_work_schedule(&wdt_work, K_NO_WAIT);
#endif
}

static void run_wdt_work(struct k_work *item)
{
    task_wdt_feed(kernal_wdt_id);
    k_work_schedule(&wdt_work, K_MSEC(TASK_WDT_FEED_INTERVAL_MS));
}

int main(void)
{
#ifdef CONFIG_SPI_FLASH_LOADER
    if (bootmode_check(ZSW_BOOT_MODE_RTT_FLASH_LOADER)) {
        LOG_WRN("SPI Flash Loader Boot Mode");
        zsw_rtt_flash_loader_start();
        return 0;
    } else if (bootmode_check(ZSW_BOOT_MODE_FLASH_ERASE)) {
        zsw_rtt_flash_loader_erase_external();
    }
#endif
    // The init code requires a bit of stack.
    // So in order to not increase CONFIG_MAIN_STACK_SIZE and loose
    // this RAM forever, instead re-use the system workqueue for init
    // it has the required amount of stack.
    k_work_submit(&init_work);

    // Workaround due to https://github.com/zephyrproject-rtos/zephyr/issues/71410
    // we need to run lv_task_handler from main thread and disable CONFIG_LV_Z_FLUSH_THREAD
#ifdef CONFIG_BOARD_NATIVE_POSIX
    int64_t next_update_in_ms;
    while (true) {
        next_update_in_ms = lv_task_handler();
        k_msleep(next_update_in_ms);
    }
#endif

    return 0;
}

static void enable_bluetooth(void)
{
    int err;

#ifdef CONFIG_BOARD_NATIVE_POSIX
    bt_addr_le_t addr;

    err = bt_addr_le_from_str("DE:AD:BE:EF:BA:11", "random", &addr);
    if (err) {
        LOG_ERR("Invalid BT address (err %d)", err);
    }

    err = bt_id_create(&addr, NULL);
    if (err < 0) {
        LOG_ERR("Creating new ID failed (err %d)", err);
    }
#endif

    err = bt_enable(NULL);

#ifdef CONFIG_SETTINGS
    settings_load();
#endif
    if (err != 0) {
        LOG_ERR("Failed to enable Bluetooth, err: %d", err);
        return;
    }

    __ASSERT_NO_MSG(ble_comm_init() == 0);
    bleAoaInit();

    ble_ams_init();
    ble_cts_init();
    ble_ancs_init();
}

static void print_retention_ram(void)
{
    LOG_DBG("Boot count: %u\n", retained.boots);
    LOG_DBG("uptime_latest: %" PRIu64 "\n", retained.uptime_latest);
    LOG_DBG("Active Ticks: %" PRIu64 "\n", retained.uptime_sum);
}

static void open_notification_popup(void *data)
{
    zsw_not_mngr_notification_t *not = zsw_notification_manager_get_newest();
    if (not != NULL) {
        lv_group_set_default(temp_group);
        lv_indev_set_group(enc_indev, temp_group);
        zsw_vibration_run_pattern(ZSW_VIBRATION_PATTERN_NOTIFICATION);
        zsw_notification_popup_show(not->sender, not->body, not->src, not->id, on_popup_notifcation_closed, 10);
        is_buttons_for_lvgl = true;
    }
    pending_not_open = false;
}

static void open_application_manager_page(void *app_name)
{
    watchface_app_stop();
    is_buttons_for_lvgl = true;
    watch_state = APPLICATION_MANAGER_STATE;
    zsw_app_manager_show(on_application_manager_close, root_screen, input_group, (char *)app_name);
}

static void close_popup_notification(lv_timer_t *timer)
{
    uint32_t id;

    id = (uint32_t)timer->user_data;
    // Notification was dismissed, hence consider it read.
    zsw_notification_manager_remove(id);

    lv_group_set_default(input_group);
    lv_indev_set_group(enc_indev, input_group);
    if (watch_state == WATCHFACE_STATE) {
        is_buttons_for_lvgl = 0;
    } else {
        is_buttons_for_lvgl = 1;
    }
}

static void on_popup_notifcation_closed(uint32_t id)
{
    lv_timer_t *timer;
    // Changing back input group directly here causes LVGL
    // to not remove the notifcation for some reason.
    // Maybe a bug, or something done wrong.
    // Anyway doing it after a while instead seems to fix
    // the problem.
    timer = lv_timer_create(close_popup_notification, 500,  (void *)id);
    lv_timer_set_repeat_count(timer, 1);
}

static void on_application_manager_close(void)
{
    zsw_app_manager_delete();
    watch_state = WATCHFACE_STATE;
    watchface_app_start(root_screen, input_group, on_watchface_app_event_callback);
    lv_async_call(async_turn_off_buttons_allocation, NULL);
}

static void async_turn_off_buttons_allocation(void *unused)
{
    is_buttons_for_lvgl = false;
}

static void on_input_subsys_callback(struct input_event *evt)
{
    // Currently you have to define a keycode as binding between buttons and longpress. We skip this binding codes for now.
    // Also touch events will be skipped, because they are handled by LVGL.
    // TODO: Charger is also ignored for now.
    // TODO: Replace this filtering with a propper device filtering setup for the input handler
    if ((evt->code == INPUT_ABS_X) || (evt->code == INPUT_ABS_Y) || (evt->code == INPUT_BTN_TOUCH) ||
        (evt->code == INPUT_KEY_KP0) || (evt->code == INPUT_KEY_POWER) || (evt->value == 1)) {
        return;
    }

    input_worker_item.event = *evt;
    input_worker_item.work = input_work;
    k_work_submit(&input_worker_item.work);
}

static void handle_screen_gesture(lv_dir_t event_code)
{
    if (watch_state == WATCHFACE_STATE && !zsw_notification_popup_is_shown()) {
        switch (event_code) {
            case LV_DIR_LEFT: {
                open_application_manager_page("Notification");
                break;
            }
            case LV_DIR_RIGHT: {
                open_application_manager_page("Watchface Picker");
                break;
            }
            case LV_DIR_TOP: {
                open_application_manager_page(NULL);
                break;
            }
            case LV_DIR_BOTTOM: {
                break;
            }
            default:
                __ASSERT(false, "Not a valid gesture code: %d", event_code);
        }
        lv_indev_wait_release(lv_indev_get_act());
    } else if (zsw_notification_popup_is_shown()) {
        zsw_notification_popup_remove();
    }
}

static void on_lvgl_screen_gesture_event_callback(lv_event_t *e)
{
    lv_dir_t  dir;
    lv_event_code_t event = lv_event_get_code(e);
    if (event == LV_EVENT_GESTURE) {
        dir = lv_indev_get_gesture_dir(lv_indev_get_act());
        handle_screen_gesture(dir);
    }
}

static void enocoder_read(struct _lv_indev_drv_t *indev_drv, lv_indev_data_t *data)
{
    if (!is_buttons_for_lvgl) {
        return;
    }

    if (last_input_event.code == INPUT_KEY_4) {
        data->key = LV_KEY_LEFT;
        data->state = LV_INDEV_STATE_PR;
        last_pressed = 2;
    } else if (last_input_event.code == INPUT_KEY_1) {
        data->key = LV_KEY_ENTER;
        data->state = LV_INDEV_STATE_PR;
        last_pressed = 1;
    } else if (last_input_event.code == INPUT_KEY_2) {
        data->key = LV_KEY_RIGHT;
        data->state = LV_INDEV_STATE_PR;
        last_pressed = 3;
    } else if (last_input_event.code == INPUT_KEY_3) {
        // Not used for now. TODO exit/back button.
    } else {
        if (last_pressed == 0xFF) {
            return;
        }
        data->state = LV_INDEV_STATE_REL;
        switch (last_pressed) {
            case 2:
                data->key = LV_KEY_RIGHT;
                break;
            case 1:
                data->key = LV_KEY_ENTER;
                break;
            case 3:
                data->key = LV_KEY_LEFT;
                break;
            default:
                break;
        }
        last_pressed = 0xFF;
    }

    last_input_event.code = 0xFF;
}

static void on_watchface_app_event_callback(watchface_app_evt_t evt)
{
    if (watch_state == WATCHFACE_STATE && !zsw_notification_popup_is_shown()) {
        switch (evt.type) {
            case WATCHFACE_APP_EVENT_OPEN_APP:
                switch (evt.data.app) {
                    case WATCHFACE_APP_EVT_CLICK_BATT:
                        open_application_manager_page("Battery");
                        break;
                    case WATCHFACE_APP_EVT_CLICK_STEP:
                        break;
                    case WATCHFACE_APP_EVT_CLICK_WEATHER:
                        break;
                    case WATCHFACE_APP_EVT_CLICK_MUSIC:
                        open_application_manager_page("Music");
                        break;
                    case WATCHFACE_APP_EVT_CLICK_SETTINGS:
                        open_application_manager_page("Settings");
                        break;
                    case WATCHFACE_APP_EVT_CLICK_FLASHLIGHT:
                        open_application_manager_page("Flashlight");
                        break;
                    default:
                        break;
                }
                break;
            case WATCHFACE_APP_EVENT_SET_BRIGHTNESS:
                zsw_display_control_set_brightness(evt.data.brightness);
                zsw_settings_brightness_t brightness = evt.data.brightness;
                if (evt.data.store_brightness) {
                    settings_save_one(ZSW_SETTINGS_BRIGHTNESS, &brightness, sizeof(brightness));
                }
                break;
            case WATCHFACE_APP_EVENT_RESTART:
                sys_reboot(SYS_REBOOT_COLD);
                break;
            case WATCHFACE_APP_EVENT_SHUTDOWN:
#if CONFIG_DT_HAS_NORDIC_NPM1300_ENABLED
                int ret = zsw_pmic_power_down();
                if (ret) {
                    LOG_ERR("Failed to power down the system");
                }
#endif
                break;
        }
    }
}

static void click_feedback(struct _lv_indev_drv_t *drv, uint8_t e)
{
    if (e == LV_EVENT_CLICKED) {
        zsw_vibration_run_pattern(ZSW_VIBRATION_PATTERN_CLICK);
    }
}

static void on_zbus_notification_callback(const struct zbus_channel *chan)
{
    if (zsw_notification_popup_is_shown() || pending_not_open) {
        return;
    }

    if (zsw_power_manager_get_state() != ZSW_ACTIVITY_STATE_NOT_WORN_STATIONARY) {
        pending_not_open = true;
        zsw_power_manager_reset_idle_timout();
        lv_async_call(open_notification_popup, NULL);
    }
}

static void on_zbus_ble_data_callback(const struct zbus_channel *chan)
{
    const struct ble_data_event *event = zbus_chan_const_msg(chan);

    switch (event->data.type) {
        case BLE_COMM_DATA_TYPE_SET_TIME: {
            if (event->data.data.time.seconds > 0) {
                struct timespec tspec;
                tspec.tv_sec = event->data.data.time.seconds;
                tspec.tv_nsec = 0;

                clock_settime(CLOCK_REALTIME, &tspec);
            }

            if (event->data.data.time.tz_offset != 0) {
                char tz[sizeof("UTC+01")] = { '\0' };
                char sign = (event->data.data.time.tz_offset < 0) ? '+' : '-';
                snprintf(tz, sizeof(tz), "UTC%c%d", sign, MIN(abs(event->data.data.time.tz_offset), 99));
                setenv("TZ", tz, 1);
                tzset();
            }
            break;
        }
        case BLE_COMM_DATA_TYPE_WEATHER:
            break;
        case BLE_COMM_DATA_TYPE_REMOTE_CONTROL:
            // TODO: Add correct enum
            if (event->data.data.remote_control.button == 4) {
                zsw_power_manager_reset_idle_timout();
                if (watch_state == APPLICATION_MANAGER_STATE) {
                    zsw_app_manager_delete();
                    zsw_app_manager_set_index(0);
                    is_buttons_for_lvgl = false;
                    watch_state = WATCHFACE_STATE;
                    watchface_app_start(root_screen, input_group, on_watchface_app_event_callback);
                }
            } else {
                // TODO: Can we rework it with triggering input events?
                //button_set_fake_press((buttonId_t)event->data.data.remote_control.button, true);
            }

            break;
        default:
            break;
    }
}

#ifndef CONFIG_RESET_ON_FATAL_ERROR
void k_sys_fatal_error_handler(unsigned int reason, const z_arch_esf_t *esf)
{
    ARG_UNUSED(esf);
    ARG_UNUSED(reason);

    LOG_PANIC();

    LOG_ERR("Resetting system");
    sys_reboot(SYS_REBOOT_COLD);

    CODE_UNREACHABLE;
}
#endif
```
